## conf/distro/oniro-openharmony-linux.conf
```bitbake
# SPDX-FileCopyrightText: Huawei Inc.
#
# SPDX-License-Identifier: Apache-2.0

DISTRO = "oniro-openharmony-linux"
DISTRO_NAME = "Oniro/OpenHarmony Linux Distro"
DISTRO_VERSION = "1.99.99"

# LLVM/Clang toolchain
TOOLCHAIN = "clang"
RUNTIME = "llvm"

# musl libc
TCLIBC = "musl"

# Linux kernel version
PREFERRED_VERSION_linux-yocto = "5.10.%"

QB_KERNEL_CMDLINE_APPEND += "init=/init bootopt=64S3,32N2,64N2 systempart=/dev/mapper/system hardware=x23 ohos.boot.sn=0a20230726rpi"
```

## conf/distro/openharmony.conf
```bitbake
# SPDX-FileCopyrightText: Huawei Inc.
#
# SPDX-License-Identifier: Apache-2.0

DISTRO = "openharmony"
DISTRO_NAME = "Oniro/OpenHarmony Linux Distro"

# Linux kernel version
PREFERRED_VERSION_linux-yocto = "5.10.%"

INIT_MANAGER = "systemd"

DISTRO_FEATURES += "virtualization"
DISTRO_FEATURES_NATIVE += "opengl x11"
```
